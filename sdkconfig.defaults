## sdkconfig.defaults
```kconfig
# Rust often needs a bit of an extra main task stack size compared to C (the default is 3K)
CONFIG_ESP_MAIN_TASK_STACK_SIZE=32000

# Use this to set FreeRTOS kernel tick frequency to 1000 Hz (100 Hz by default).
# This allows to use 1 ms granularity for thread sleeps (10 ms by default).
#CONFIG_FREERTOS_HZ=1000

# Uncomment to enable debug-level logging output (verbose, useful for diagnosing boot issues)
#CONFIG_LOG_DEFAULT_LEVEL_DEBUG=y
#CONFIG_LOG_MAXIMUM_LEVEL_DEBUG=y

# TLS certificate bundle enabled by default (needed for OrangeClock HTTPS API calls)
# See https://github.com/espressif/esp-idf/issues/7631
```
